## Kconfig
```kconfig
# Copyright (c) 2025 Core Devices LLC
# SPDX-License-Identifier: Apache-2.0

rsource "lib/Kconfig"
```

## boards/coredevices/pt2/board.yml
```yaml
# Copyright (c) 2025 Core Devices LLC
# SPDX-License-Identifier: Apache-2.0

board:
  name: pt2
  vendor: coredevices
  socs:
    - name: sf32lb52jud6
```

## drivers/console/Kconfig
```kconfig
# Copyright (c) 2025 Core Devices LLC
# SPDX-License-Identifier: Apache-2.0

menuconfig CONSOLE_EXT
	bool "Console Drivers (external)"
	default y if CONSOLE
	help
	  Enable external console drivers.

if CONSOLE_EXT

config PULSE_UART_CONSOLE
	bool "Pulse UART Console Driver"
	depends on SERIAL && SERIAL_HAS_DRIVER
	depends on CRC
	select PB_COBS
	select CONSOLE_HAS_DRIVER
	help
	  Enable the Pulse UART console driver.

	  This driver provides console output over a UART interface using the
	  Pulse protocol.

endif # CONSOLE_EXT
```

## lib/pb/bootbit/Kconfig
```kconfig
# Copyright (c) 2025 Core Devices LLC
# SPDX-License-Identifier: Apache-2.0

config PB_BOOTBIT
    bool "Boot bit library"
    help
      Enable the boot bit library.


if PB_BOOTBIT

config PB_BOOTBIT_SF32LB
    bool "Boot bit SF32LB backend"
    default y if SOC_FAMILY_SF32
    depends on SOC_FAMILY_SF32
    help
      Enable boot bit SF32LB backend.

endif # BOOTBIT
```

## lib/pb/cobs/Kconfig
```kconfig
# Copyright (c) 2025 Core Devices LLC
# SPDX-License-Identifier: Apache-2.0

config PB_COBS
    bool "COBS library"
    help
      COBS encoding library.
```

## lib/pb/fwjump/Kconfig
```kconfig
# Copyright (c) 2025 Core Devices LLC
# SPDX-License-Identifier: Apache-2.0

config PB_FWJUMP
    bool "Firmware jump library"
    help
      Enable the firmware jump library.


if PB_FWJUMP

config PB_FWJUMP_ARM_CM
    bool "Firmware jump ARM Cortex-M backend"
    default y if CPU_CORTEX_M
    depends on CPU_CORTEX_M
    help
      Enable the firmware jump ARM Cortex-M backend.

endif # PB_FWJUMP
```

## west.yml
```yaml
# Copyright (c) 2025 Core Devices LLC
# SPDX-License-Identifier: Apache-2.0

manifest:
  remotes:
    - name: coredevices
      url-base: https://github.com/coredevices

  projects:
    - name: zephyr
      remote: coredevices
      revision: pblboot
      import:
        name-allowlist:
          - cmsis_6
          - hal_sifli
```
